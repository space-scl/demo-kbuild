## KConfig
```kconfig
mainmenu "My kconfig learning"

# Use config symbol to get environment variable
config ENV_VAR_1
    string
    option env="ENV_VAR"

config SELECT_DESTINATION_TTY
    bool "save data to tty"
    default n
    help
      Write destination file with relative or full path
config SELECT_DESTINATION_FILE
    bool "save data to file"
    default y


comment "Destination file"
config SELECT_DESTINATION_FILE_FILENAME
    string "destination file"
    depends on SELECT_DESTINATION_FILE
    default "test.log" if ENV_VAR_1="n"
    help
      Write destination file with relative or full path

config SHOW_ONLY_CURRENT_USER
    bool "show data only for current user"
    default y
    help
      script will get data only for currewnt user

config MY_MODULE
    tristate "Enable My Module"
    default n
    help
      This option enables My Module. When enabled, additional
      configuration options for My Module will be available.

comment "My Feature example to show how to use menuconfig"
source menuconfig.kconfig

source choice.kconfig

if ENV_VAR_1 = "y"
source menu.kconfig
endif

source have.kconfig
```
